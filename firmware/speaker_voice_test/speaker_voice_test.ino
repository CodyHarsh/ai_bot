/*
  SPEAKER VOICE TEST  (speaker only: no microphone, no OLED needed)

  It makes the speaker SAY something:  "Hello! I am Pip. Can you hear me?"
  The voice is stored inside this sketch, so it needs NO WiFi and NO server.

  Wiring (amp only):  MAX98357A  VIN -> ESP32 5V     GND -> GND
                                 BCLK -> GPIO14      LRC -> GPIO25      DIN -> GPIO22
                      speaker wires on the amp's + and - screw terminals (NOT on GND)

  What happens: at power-up it plays 3 beeps, then the voice, then waits for keys in the Serial Monitor (115200).
  Keys:  1 beeps   2 built-in voice   3 voice from your Mac server (set USE_SERVER)   4 wiring sweep
         + / -  volume     a  play everything again     m  menu
  Nothing audible? Press 4: it tries BCLK/LRC the other way round and says which one you should hear.
*/
#include <ESP_I2S.h>
#include <WiFi.h>

// ---- settings -----------------------------------------------------------------------------
#define USE_SERVER   0              // 1 = also fetch a voice from the Mac server (key 3). Needs the lines below.
#define WIFI_SSID    "YOUR_WIFI_NAME"
#define WIFI_PASS    "YOUR_WIFI_PASSWORD"
#define SERVER_HOST  "192.168.1.50" // your Mac's current IP, the server must be running
#define SERVER_PORT  8000
#define SERVER_TEXT  "Hello! I am Pip. I am talking from the server."

#define PIN_BCLK 14
#define PIN_WS   25
#define PIN_DOUT 22
#define PIN_DIN  33                 // set but never read: the microphone is not used here
#define PIN_LED  2

int volumePct = 200;                // 100 = as recorded. 200 = louder (soft limited). Keys + and - change it.
// ---------------------------------------------------------------------------------------------

#define LOGI(tag, ...) do { Serial.printf("[%8lu] %-5s ", millis(), tag); Serial.printf(__VA_ARGS__); Serial.println(); } while (0)

I2SClass i2s;
bool i2sOn = false;
int curBclk = PIN_BCLK, curWs = PIN_WS;
unsigned long totalWritten = 0;

// 8 kHz mu-law speech: "Hello! I am Pip. Can you hear me?"  (26612 bytes, about 3.3 seconds)
const uint8_t VOICE_ULAW[] PROGMEM = {
  0xFF,0xFF,0xFF,0xFF,0xFF,0xFF,0xFF,0xFF,0xFF,0xFF,0xFF,0xFF,0xFF,0xFF,0xFF,0xFF,0xFF,0xFF,0xFF,0xFF,
  0xFF,0xFF,0xFF,0xFF,0xFF,0xFF,0xFF,0xFF,0xFF,0xFF,0xFF,0xFF,0xFF,0xFF,0xFF,0xFF,0xFF,0xFF,0xFF,0xFF,
  0xFF,0xFF,0xFF,0xFF,0xFF,0xFF,0xFF,0xFF,0xFF,0xFF,0xFF,0xFF,0xFF,0xFF,0xFF,0xFF,0xFF,0xFF,0xFF,0xFF,
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  0xFF,0xFF,0xFF,0x7E,0xFF,0xFF,0xFF,0xFF,0xFF,0xFF,0xFF,0xFF
};

int16_t ulawDecode(uint8_t u) {
  u = ~u;
  int t = ((u & 0x0F) << 3) + 0x84;
  t <<= (u & 0x70) >> 4;
  return (u & 0x80) ? (0x84 - t) : (t - 0x84);
}

inline int32_t amplify(int16_t s) {   // volume with a soft limiter: loud peaks are squeezed, not cut off
  int32_t v = ((int32_t)s * volumePct) / 100;
  const int32_t knee = 20000;
  if (v > knee) v = knee + (v - knee) / 4;
  else if (v < -knee) v = -knee + (v + knee) / 4;
  return constrain(v, -32767, 32767);
}

bool startI2S(int bclk, int ws) {
  if (i2sOn) { i2s.end(); i2sOn = false; }
  curBclk = bclk; curWs = ws;
  i2s.setPins(bclk, ws, PIN_DOUT, PIN_DIN);
  if (!i2s.begin(I2S_MODE_STD, 16000, I2S_DATA_BIT_WIDTH_32BIT, I2S_SLOT_MODE_STEREO, I2S_STD_SLOT_BOTH)) {
    LOGI("I2S", "FAILED to start (BCLK=%d WS=%d DOUT=%d)", bclk, ws, PIN_DOUT);
    return false;
  }
  i2sOn = true;
  LOGI("I2S", "speaker output started: 16 kHz, BCLK=GPIO%d LRC=GPIO%d DIN=GPIO%d", bclk, ws, PIN_DOUT);
  return true;
}

// Writes mono 16-bit samples to the amp as stereo 32-bit. Returns the loudest sample played (0..32767).
int writeFrames(const int16_t* s, int n, bool* stuck) {
  static int32_t out[2 * 128];
  int peak = 0;
  for (int i = 0; i < n; i += 128) {
    int m = min(128, n - i);
    for (int k = 0; k < m; k++) {
      int32_t v = amplify(s[i + k]);
      if (abs(v) > peak) peak = abs(v);
      out[2 * k] = out[2 * k + 1] = v << 16;
    }
    size_t want = (size_t)m * 8, got = i2s.write((uint8_t*)out, want);
    totalWritten += got;
    if (got != want && stuck) *stuck = true;
  }
  return peak;
}

void silence(int ms) {
  int16_t z[160] = {0};
  for (int i = 0; i < ms / 10; i++) writeFrames(z, 160, nullptr);
}

void report(const char* what, int peak, unsigned long took, unsigned long expected, bool stuck) {
  LOGI("PLAY", "%s: loudest sample %d%% of full scale, took %lu ms (audio is %lu ms)", what, peak * 100 / 32767, took, expected);
  if (stuck) LOGI("PLAY", "WARNING: the I2S driver did not accept all data (timeouts). The I2S clock may not be running");
  if (took + 150 < expected) LOGI("PLAY", "WARNING: finished much faster than the audio is long. The amp is not consuming data: check BCLK/LRC wires");
  if (peak < 800) LOGI("PLAY", "WARNING: the signal is almost silent (volume too low?)");
}

void beeps() {
  LOGI("TEST", "3 beeps (low, middle, high)");
  digitalWrite(PIN_LED, HIGH);
  float freqs[3] = {500, 800, 1200};
  static float phase = 0;
  for (int b = 0; b < 3; b++) {
    unsigned long t0 = millis();
    int16_t buf[160]; int peak = 0; bool stuck = false;
    for (int blk = 0; blk < 25; blk++) {                 // 25 x 10 ms = 250 ms
      for (int i = 0; i < 160; i++) { buf[i] = (int16_t)(sin(phase) * 9000); phase += 2 * PI * freqs[b] / 16000; }
      peak = max(peak, writeFrames(buf, 160, &stuck));
    }
    char nm[24]; snprintf(nm, sizeof(nm), "beep %d (%d Hz)", b + 1, (int)freqs[b]);
    report(nm, peak, millis() - t0, 250, stuck);
    silence(150);
  }
  digitalWrite(PIN_LED, LOW);
}

void sayBuiltIn() {
  int n = sizeof(VOICE_ULAW);
  LOGI("TEST", "saying the built-in voice (%d bytes, volume %d%%)", n, volumePct);
  digitalWrite(PIN_LED, HIGH);
  unsigned long t0 = millis();
  int16_t buf[128]; int peak = 0; bool stuck = false;
  int16_t prev = 0;
  int pos = 0;
  while (pos < n) {                                       // 8 kHz -> 16 kHz: the midpoint, then the sample itself
    int m = 0;
    while (m < 128 && pos < n) {
      int16_t cur = ulawDecode(pgm_read_byte(&VOICE_ULAW[pos++]));
      buf[m++] = (prev + cur) / 2;
      buf[m++] = cur;
      prev = cur;
    }
    peak = max(peak, writeFrames(buf, m, &stuck));
  }
  silence(200);
  report("built-in voice", peak, millis() - t0, (unsigned long)n * 1000 / 8000, stuck);
  digitalWrite(PIN_LED, LOW);
}

String urlEncode(const char* s) {
  String o; char h[4];
  for (; *s; s++) {
    if (isalnum((unsigned char)*s) || *s == '-' || *s == '_' || *s == '.') o += *s;
    else { snprintf(h, sizeof(h), "%%%02X", (unsigned char)*s); o += h; }
  }
  return o;
}

void sayFromServer() {
#if USE_SERVER
  if (WiFi.status() != WL_CONNECTED) {
    LOGI("NET", "WiFi is not connected. Check WIFI_SSID / WIFI_PASS (2.4 GHz network)");
    return;
  }
  LOGI("NET", "asking %s:%d for a voice: \"%s\"", SERVER_HOST, SERVER_PORT, SERVER_TEXT);
  unsigned long t0 = millis();
  WiFiClient c;
  if (!c.connect(SERVER_HOST, SERVER_PORT, 3000)) {
    LOGI("NET", "cannot connect. Check SERVER_HOST (your Mac's CURRENT IP), same WiFi, firewall, server running");
    return;
  }
  c.print(String("GET /api/say?text=") + urlEncode(SERVER_TEXT) + " HTTP/1.1\r\nHost: " + SERVER_HOST + "\r\nConnection: close\r\n\r\n");
  while (!c.available() && c.connected() && millis() - t0 < 30000) delay(5);
  if (!c.available()) { LOGI("NET", "no answer from the server after %lu ms (see the server terminal)", millis() - t0); c.stop(); return; }
  String status = c.readStringUntil('\n');
  int code = status.substring(9, 12).toInt();
  long remaining = -1;
  while (true) {
    String l = c.readStringUntil('\n');
    if (l.length() <= 1) break;
    l.trim(); l.toLowerCase();
    if (l.startsWith("content-length:")) remaining = l.substring(15).toInt();
  }
  LOGI("NET", "server answered HTTP %d after %lu ms, voice %ld bytes", code, millis() - t0, remaining);
  if (code != 200 || remaining <= 0) {
    LOGI("NET", "no voice received. Open http://%s:%d/api/say.wav?text=hello in your browser and read the server terminal", SERVER_HOST, SERVER_PORT);
    c.stop();
    return;
  }
  digitalWrite(PIN_LED, HIGH);
  unsigned long t1 = millis(), lastData = millis();
  long got = 0; int peak = 0; bool stuck = false;
  alignas(4) static uint8_t raw[512];
  int carry = -1;
  while (got < remaining) {
    int avail = c.available();
    if (avail <= 0) {
      if (!c.connected() || millis() - lastData > 4000) break;
      delay(2);
      continue;
    }
    int r = c.read(raw, min(avail, (int)sizeof(raw)));
    if (r <= 0) continue;
    lastData = millis();
    int16_t s[256]; int m = 0;
    for (int i = 0; i < r; i++) {
      if (carry < 0) carry = raw[i];
      else { s[m++] = (int16_t)(carry | (raw[i] << 8)); carry = -1; }
    }
    got += r;
    peak = max(peak, writeFrames(s, m, &stuck));
  }
  silence(200);
  c.stop();
  report("server voice", peak, millis() - t1, (unsigned long)got / 32, stuck);
  digitalWrite(PIN_LED, LOW);
#else
  LOGI("NET", "server voice is switched off. Set USE_SERVER 1 at the top of the sketch and fill in the WIFI_ and SERVER_ lines");
#endif
}

void checklist() {
  Serial.println();
  Serial.println("---- heard nothing? check in this order ----");
  Serial.println(" 1. amp VIN is on the ESP32 5V pin (not 3V3), amp GND on a GND pin");
  Serial.println(" 2. amp DIN -> GPIO22,  BCLK -> GPIO14,  LRC -> GPIO25 (look at which pin each wire really lands on)");
  Serial.println(" 3. speaker wires on the amp's two screw terminals (+ and -). Neither wire goes to GND");
  Serial.println(" 4. the amp's SD pin: leave it empty, or on 3V3. If it goes to GND the amp is muted");
  Serial.println(" 5. amp GAIN pin: leave empty. Speaker must be 4-8 ohm. The speaker itself might be broken: try another");
  Serial.println(" 6. press 4: it tries BCLK and LRC swapped");
  Serial.println("--------------------------------------------");
}

void wiringSweep() {
  LOGI("SWEEP", "trying BCLK/LRC both ways. Listen: which round is audible?");
  int pairs[2][2] = {{PIN_BCLK, PIN_WS}, {PIN_WS, PIN_BCLK}};
  for (int r = 0; r < 2; r++) {
    LOGI("SWEEP", "round %d: BCLK=GPIO%d LRC=GPIO%d", r + 1, pairs[r][0], pairs[r][1]);
    startI2S(pairs[r][0], pairs[r][1]);
    sayBuiltIn();
    delay(800);
  }
  LOGI("SWEEP", "Heard ONLY round 2: the BCLK and LRC wires are swapped. Swap them and run again");
  LOGI("SWEEP", "Heard NOTHING in both rounds: it is power, ground, DIN or the speaker wires (see the checklist)");
  startI2S(PIN_BCLK, PIN_WS);
}

void menu() {
  Serial.println();
  Serial.printf("keys:  1 beeps   2 built-in voice   3 server voice%s   4 wiring sweep   + / - volume (now %d%%)   a all   m menu\n",
                USE_SERVER ? "" : " (off)", volumePct);
}

void runAll() {
  beeps();
  delay(300);
  sayBuiltIn();
  if (USE_SERVER) { delay(300); sayFromServer(); }
  checklist();
  menu();
}

void setup() {
  Serial.begin(115200);
  pinMode(PIN_LED, OUTPUT);
  delay(800);
  Serial.println();
  Serial.println("=== SPEAKER VOICE TEST ===");
  Serial.println("If the speaker works you will hear 3 beeps, then a voice saying: Hello! I am Pip. Can you hear me?");
  if (!startI2S(PIN_BCLK, PIN_WS)) { while (true) { digitalWrite(PIN_LED, !digitalRead(PIN_LED)); delay(100); } }
#if USE_SERVER
  LOGI("NET", "connecting to WiFi \"%s\"...", WIFI_SSID);
  WiFi.mode(WIFI_STA);
  WiFi.begin(WIFI_SSID, WIFI_PASS);
  unsigned long t0 = millis();
  while (WiFi.status() != WL_CONNECTED && millis() - t0 < 12000) delay(200);
  if (WiFi.status() == WL_CONNECTED) LOGI("NET", "WiFi connected, IP %s", WiFi.localIP().toString().c_str());
  else LOGI("NET", "WiFi did not connect in 12 s (key 3 will not work)");
#endif
  runAll();
}

void loop() {
  if (!Serial.available()) { delay(10); return; }
  char k = Serial.read();
  if (k == '1') beeps();
  else if (k == '2') sayBuiltIn();
  else if (k == '3') sayFromServer();
  else if (k == '4') { wiringSweep(); checklist(); }
  else if (k == '+' || k == '=') { volumePct = min(volumePct + 25, 400); LOGI("VOL", "volume %d%%", volumePct); }
  else if (k == '-') { volumePct = max(volumePct - 25, 25); LOGI("VOL", "volume %d%%", volumePct); }
  else if (k == 'a') runAll();
  else if (k == 'm') menu();
}
